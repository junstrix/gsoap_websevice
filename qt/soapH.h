/* soapH.h
   Generated by gSOAP 2.8.15 from gsoapControl.h

Copyright(C) 2000-2013, Robert van Engelen, Genivia Inc. All Rights Reserved.
The generated code is released under ONE of the following licenses:
GPL or Genivia's license for commercial use.
This program is released under the GPL with the additional exemption that
compiling, linking, and/or using OpenSSL is allowed.
*/

#ifndef soapH_H
#define soapH_H
#include "soapStub.h"
#ifndef WITH_NOIDREF

#ifdef __cplusplus
extern "C" {
#endif
SOAP_FMAC3 void SOAP_FMAC4 soap_markelement(struct soap*, const void*, int);

#ifdef __cplusplus
}
#endif
SOAP_FMAC3 int SOAP_FMAC4 soap_putindependent(struct soap*);
SOAP_FMAC3 int SOAP_FMAC4 soap_getindependent(struct soap*);
#endif

#ifdef __cplusplus
extern "C" {
#endif
SOAP_FMAC3 void *SOAP_FMAC4 soap_getelement(struct soap*, int*);
SOAP_FMAC3 int SOAP_FMAC4 soap_putelement(struct soap*, const void*, const char*, int, int);

#ifdef __cplusplus
}
#endif
SOAP_FMAC3 int SOAP_FMAC4 soap_ignore_element(struct soap*);

SOAP_FMAC3 const char ** SOAP_FMAC4 soap_faultcode(struct soap *soap);

SOAP_FMAC3 void * SOAP_FMAC4 soap_instantiate(struct soap*, int, const char*, const char*, size_t*);
SOAP_FMAC3 int SOAP_FMAC4 soap_fdelete(struct soap_clist*);
SOAP_FMAC3 void* SOAP_FMAC4 soap_class_id_enter(struct soap*, const char*, void*, int, size_t, const char*, const char*);

#ifndef SOAP_TYPE_byte
#define SOAP_TYPE_byte (3)
#endif
SOAP_FMAC3 void SOAP_FMAC4 soap_default_byte(struct soap*, char *);
SOAP_FMAC3 int SOAP_FMAC4 soap_out_byte(struct soap*, const char*, int, const char *, const char*);
SOAP_FMAC3 char * SOAP_FMAC4 soap_in_byte(struct soap*, const char*, char *, const char*);

SOAP_FMAC3 int SOAP_FMAC4 soap_put_byte(struct soap*, const char *, const char*, const char*);

#ifndef soap_write_byte
#define soap_write_byte(soap, data) ( soap_serialize_byte(soap, data), soap_begin_send(soap) || soap_put_byte(soap, data, "byte", NULL) || soap_end_send(soap), soap->error )
#endif

SOAP_FMAC3 char * SOAP_FMAC4 soap_get_byte(struct soap*, char *, const char*, const char*);

#ifndef soap_read_byte
#define soap_read_byte(soap, data) ( soap_begin_recv(soap) || !soap_get_byte(soap, data, NULL, NULL) || soap_end_recv(soap), soap->error )
#endif


#ifndef SOAP_TYPE_int
#define SOAP_TYPE_int (1)
#endif
SOAP_FMAC3 void SOAP_FMAC4 soap_default_int(struct soap*, int *);
SOAP_FMAC3 int SOAP_FMAC4 soap_out_int(struct soap*, const char*, int, const int *, const char*);
SOAP_FMAC3 int * SOAP_FMAC4 soap_in_int(struct soap*, const char*, int *, const char*);

SOAP_FMAC3 int SOAP_FMAC4 soap_put_int(struct soap*, const int *, const char*, const char*);

#ifndef soap_write_int
#define soap_write_int(soap, data) ( soap_serialize_int(soap, data), soap_begin_send(soap) || soap_put_int(soap, data, "int", NULL) || soap_end_send(soap), soap->error )
#endif

SOAP_FMAC3 int * SOAP_FMAC4 soap_get_int(struct soap*, int *, const char*, const char*);

#ifndef soap_read_int
#define soap_read_int(soap, data) ( soap_begin_recv(soap) || !soap_get_int(soap, data, NULL, NULL) || soap_end_recv(soap), soap->error )
#endif


#ifndef WITH_NOGLOBAL

#ifndef SOAP_TYPE_SOAP_ENV__Fault
#define SOAP_TYPE_SOAP_ENV__Fault (30)
#endif
SOAP_FMAC3 void SOAP_FMAC4 soap_default_SOAP_ENV__Fault(struct soap*, struct SOAP_ENV__Fault *);
SOAP_FMAC3 void SOAP_FMAC4 soap_serialize_SOAP_ENV__Fault(struct soap*, const struct SOAP_ENV__Fault *);
SOAP_FMAC3 int SOAP_FMAC4 soap_out_SOAP_ENV__Fault(struct soap*, const char*, int, const struct SOAP_ENV__Fault *, const char*);
SOAP_FMAC3 struct SOAP_ENV__Fault * SOAP_FMAC4 soap_in_SOAP_ENV__Fault(struct soap*, const char*, struct SOAP_ENV__Fault *, const char*);

SOAP_FMAC3 int SOAP_FMAC4 soap_put_SOAP_ENV__Fault(struct soap*, const struct SOAP_ENV__Fault *, const char*, const char*);

#ifndef soap_write_SOAP_ENV__Fault
#define soap_write_SOAP_ENV__Fault(soap, data) ( soap_serialize_SOAP_ENV__Fault(soap, data), soap_begin_send(soap) || soap_put_SOAP_ENV__Fault(soap, data, "SOAP-ENV:Fault", NULL) || soap_end_send(soap), soap->error )
#endif

SOAP_FMAC3 struct SOAP_ENV__Fault * SOAP_FMAC4 soap_get_SOAP_ENV__Fault(struct soap*, struct SOAP_ENV__Fault *, const char*, const char*);

#ifndef soap_read_SOAP_ENV__Fault
#define soap_read_SOAP_ENV__Fault(soap, data) ( soap_begin_recv(soap) || !soap_get_SOAP_ENV__Fault(soap, data, NULL, NULL) || soap_end_recv(soap), soap->error )
#endif

SOAP_FMAC1 struct SOAP_ENV__Fault * SOAP_FMAC2 soap_instantiate_SOAP_ENV__Fault(struct soap*, int, const char*, const char*, size_t*);

inline struct SOAP_ENV__Fault * soap_new_SOAP_ENV__Fault(struct soap *soap, int n = -1) { return soap_instantiate_SOAP_ENV__Fault(soap, n, NULL, NULL, NULL); }

inline struct SOAP_ENV__Fault * soap_new_req_SOAP_ENV__Fault(struct soap *soap) { struct SOAP_ENV__Fault *_p = soap_instantiate_SOAP_ENV__Fault(soap, -1, NULL, NULL, NULL); if (_p) { soap_default_SOAP_ENV__Fault(soap, _p); } return _p; }

inline struct SOAP_ENV__Fault * soap_new_set_SOAP_ENV__Fault(struct soap *soap, char *faultcode, char *faultstring, char *faultactor, struct SOAP_ENV__Detail *detail, struct SOAP_ENV__Code *SOAP_ENV__Code, struct SOAP_ENV__Reason *SOAP_ENV__Reason, char *SOAP_ENV__Node, char *SOAP_ENV__Role, struct SOAP_ENV__Detail *SOAP_ENV__Detail) { struct SOAP_ENV__Fault *_p = soap_instantiate_SOAP_ENV__Fault(soap, -1, NULL, NULL, NULL); if (_p) { soap_default_SOAP_ENV__Fault(soap, _p); _p->faultcode = faultcode; _p->faultstring = faultstring; _p->faultactor = faultactor; _p->detail = detail; _p->SOAP_ENV__Code = SOAP_ENV__Code; _p->SOAP_ENV__Reason = SOAP_ENV__Reason; _p->SOAP_ENV__Node = SOAP_ENV__Node; _p->SOAP_ENV__Role = SOAP_ENV__Role; _p->SOAP_ENV__Detail = SOAP_ENV__Detail; } return _p; }

inline void soap_delete_SOAP_ENV__Fault(struct soap *soap, struct SOAP_ENV__Fault *p) { soap_delete(soap, p); }

SOAP_FMAC3 void SOAP_FMAC4 soap_copy_SOAP_ENV__Fault(struct soap*, int, int, void*, size_t, const void*, size_t);

#endif

#ifndef WITH_NOGLOBAL

#ifndef SOAP_TYPE_SOAP_ENV__Reason
#define SOAP_TYPE_SOAP_ENV__Reason (29)
#endif
SOAP_FMAC3 void SOAP_FMAC4 soap_default_SOAP_ENV__Reason(struct soap*, struct SOAP_ENV__Reason *);
SOAP_FMAC3 void SOAP_FMAC4 soap_serialize_SOAP_ENV__Reason(struct soap*, const struct SOAP_ENV__Reason *);
SOAP_FMAC3 int SOAP_FMAC4 soap_out_SOAP_ENV__Reason(struct soap*, const char*, int, const struct SOAP_ENV__Reason *, const char*);
SOAP_FMAC3 struct SOAP_ENV__Reason * SOAP_FMAC4 soap_in_SOAP_ENV__Reason(struct soap*, const char*, struct SOAP_ENV__Reason *, const char*);

SOAP_FMAC3 int SOAP_FMAC4 soap_put_SOAP_ENV__Reason(struct soap*, const struct SOAP_ENV__Reason *, const char*, const char*);

#ifndef soap_write_SOAP_ENV__Reason
#define soap_write_SOAP_ENV__Reason(soap, data) ( soap_serialize_SOAP_ENV__Reason(soap, data), soap_begin_send(soap) || soap_put_SOAP_ENV__Reason(soap, data, "SOAP-ENV:Reason", NULL) || soap_end_send(soap), soap->error )
#endif

SOAP_FMAC3 struct SOAP_ENV__Reason * SOAP_FMAC4 soap_get_SOAP_ENV__Reason(struct soap*, struct SOAP_ENV__Reason *, const char*, const char*);

#ifndef soap_read_SOAP_ENV__Reason
#define soap_read_SOAP_ENV__Reason(soap, data) ( soap_begin_recv(soap) || !soap_get_SOAP_ENV__Reason(soap, data, NULL, NULL) || soap_end_recv(soap), soap->error )
#endif

SOAP_FMAC1 struct SOAP_ENV__Reason * SOAP_FMAC2 soap_instantiate_SOAP_ENV__Reason(struct soap*, int, const char*, const char*, size_t*);

inline struct SOAP_ENV__Reason * soap_new_SOAP_ENV__Reason(struct soap *soap, int n = -1) { return soap_instantiate_SOAP_ENV__Reason(soap, n, NULL, NULL, NULL); }

inline struct SOAP_ENV__Reason * soap_new_req_SOAP_ENV__Reason(struct soap *soap) { struct SOAP_ENV__Reason *_p = soap_instantiate_SOAP_ENV__Reason(soap, -1, NULL, NULL, NULL); if (_p) { soap_default_SOAP_ENV__Reason(soap, _p); } return _p; }

inline struct SOAP_ENV__Reason * soap_new_set_SOAP_ENV__Reason(struct soap *soap, char *SOAP_ENV__Text) { struct SOAP_ENV__Reason *_p = soap_instantiate_SOAP_ENV__Reason(soap, -1, NULL, NULL, NULL); if (_p) { soap_default_SOAP_ENV__Reason(soap, _p); _p->SOAP_ENV__Text = SOAP_ENV__Text; } return _p; }

inline void soap_delete_SOAP_ENV__Reason(struct soap *soap, struct SOAP_ENV__Reason *p) { soap_delete(soap, p); }

SOAP_FMAC3 void SOAP_FMAC4 soap_copy_SOAP_ENV__Reason(struct soap*, int, int, void*, size_t, const void*, size_t);

#endif

#ifndef WITH_NOGLOBAL

#ifndef SOAP_TYPE_SOAP_ENV__Detail
#define SOAP_TYPE_SOAP_ENV__Detail (26)
#endif
SOAP_FMAC3 void SOAP_FMAC4 soap_default_SOAP_ENV__Detail(struct soap*, struct SOAP_ENV__Detail *);
SOAP_FMAC3 void SOAP_FMAC4 soap_serialize_SOAP_ENV__Detail(struct soap*, const struct SOAP_ENV__Detail *);
SOAP_FMAC3 int SOAP_FMAC4 soap_out_SOAP_ENV__Detail(struct soap*, const char*, int, const struct SOAP_ENV__Detail *, const char*);
SOAP_FMAC3 struct SOAP_ENV__Detail * SOAP_FMAC4 soap_in_SOAP_ENV__Detail(struct soap*, const char*, struct SOAP_ENV__Detail *, const char*);

SOAP_FMAC3 int SOAP_FMAC4 soap_put_SOAP_ENV__Detail(struct soap*, const struct SOAP_ENV__Detail *, const char*, const char*);

#ifndef soap_write_SOAP_ENV__Detail
#define soap_write_SOAP_ENV__Detail(soap, data) ( soap_serialize_SOAP_ENV__Detail(soap, data), soap_begin_send(soap) || soap_put_SOAP_ENV__Detail(soap, data, "SOAP-ENV:Detail", NULL) || soap_end_send(soap), soap->error )
#endif

SOAP_FMAC3 struct SOAP_ENV__Detail * SOAP_FMAC4 soap_get_SOAP_ENV__Detail(struct soap*, struct SOAP_ENV__Detail *, const char*, const char*);

#ifndef soap_read_SOAP_ENV__Detail
#define soap_read_SOAP_ENV__Detail(soap, data) ( soap_begin_recv(soap) || !soap_get_SOAP_ENV__Detail(soap, data, NULL, NULL) || soap_end_recv(soap), soap->error )
#endif

SOAP_FMAC1 struct SOAP_ENV__Detail * SOAP_FMAC2 soap_instantiate_SOAP_ENV__Detail(struct soap*, int, const char*, const char*, size_t*);

inline struct SOAP_ENV__Detail * soap_new_SOAP_ENV__Detail(struct soap *soap, int n = -1) { return soap_instantiate_SOAP_ENV__Detail(soap, n, NULL, NULL, NULL); }

inline struct SOAP_ENV__Detail * soap_new_req_SOAP_ENV__Detail(struct soap *soap, int __type, void *fault) { struct SOAP_ENV__Detail *_p = soap_instantiate_SOAP_ENV__Detail(soap, -1, NULL, NULL, NULL); if (_p) { soap_default_SOAP_ENV__Detail(soap, _p); _p->__type = __type; _p->fault = fault; } return _p; }

inline struct SOAP_ENV__Detail * soap_new_set_SOAP_ENV__Detail(struct soap *soap, char *__any, int __type, void *fault) { struct SOAP_ENV__Detail *_p = soap_instantiate_SOAP_ENV__Detail(soap, -1, NULL, NULL, NULL); if (_p) { soap_default_SOAP_ENV__Detail(soap, _p); _p->__any = __any; _p->__type = __type; _p->fault = fault; } return _p; }

inline void soap_delete_SOAP_ENV__Detail(struct soap *soap, struct SOAP_ENV__Detail *p) { soap_delete(soap, p); }

SOAP_FMAC3 void SOAP_FMAC4 soap_copy_SOAP_ENV__Detail(struct soap*, int, int, void*, size_t, const void*, size_t);

#endif

#ifndef WITH_NOGLOBAL

#ifndef SOAP_TYPE_SOAP_ENV__Code
#define SOAP_TYPE_SOAP_ENV__Code (24)
#endif
SOAP_FMAC3 void SOAP_FMAC4 soap_default_SOAP_ENV__Code(struct soap*, struct SOAP_ENV__Code *);
SOAP_FMAC3 void SOAP_FMAC4 soap_serialize_SOAP_ENV__Code(struct soap*, const struct SOAP_ENV__Code *);
SOAP_FMAC3 int SOAP_FMAC4 soap_out_SOAP_ENV__Code(struct soap*, const char*, int, const struct SOAP_ENV__Code *, const char*);
SOAP_FMAC3 struct SOAP_ENV__Code * SOAP_FMAC4 soap_in_SOAP_ENV__Code(struct soap*, const char*, struct SOAP_ENV__Code *, const char*);

SOAP_FMAC3 int SOAP_FMAC4 soap_put_SOAP_ENV__Code(struct soap*, const struct SOAP_ENV__Code *, const char*, const char*);

#ifndef soap_write_SOAP_ENV__Code
#define soap_write_SOAP_ENV__Code(soap, data) ( soap_serialize_SOAP_ENV__Code(soap, data), soap_begin_send(soap) || soap_put_SOAP_ENV__Code(soap, data, "SOAP-ENV:Code", NULL) || soap_end_send(soap), soap->error )
#endif

SOAP_FMAC3 struct SOAP_ENV__Code * SOAP_FMAC4 soap_get_SOAP_ENV__Code(struct soap*, struct SOAP_ENV__Code *, const char*, const char*);

#ifndef soap_read_SOAP_ENV__Code
#define soap_read_SOAP_ENV__Code(soap, data) ( soap_begin_recv(soap) || !soap_get_SOAP_ENV__Code(soap, data, NULL, NULL) || soap_end_recv(soap), soap->error )
#endif

SOAP_FMAC1 struct SOAP_ENV__Code * SOAP_FMAC2 soap_instantiate_SOAP_ENV__Code(struct soap*, int, const char*, const char*, size_t*);

inline struct SOAP_ENV__Code * soap_new_SOAP_ENV__Code(struct soap *soap, int n = -1) { return soap_instantiate_SOAP_ENV__Code(soap, n, NULL, NULL, NULL); }

inline struct SOAP_ENV__Code * soap_new_req_SOAP_ENV__Code(struct soap *soap) { struct SOAP_ENV__Code *_p = soap_instantiate_SOAP_ENV__Code(soap, -1, NULL, NULL, NULL); if (_p) { soap_default_SOAP_ENV__Code(soap, _p); } return _p; }

inline struct SOAP_ENV__Code * soap_new_set_SOAP_ENV__Code(struct soap *soap, char *SOAP_ENV__Value, struct SOAP_ENV__Code *SOAP_ENV__Subcode) { struct SOAP_ENV__Code *_p = soap_instantiate_SOAP_ENV__Code(soap, -1, NULL, NULL, NULL); if (_p) { soap_default_SOAP_ENV__Code(soap, _p); _p->SOAP_ENV__Value = SOAP_ENV__Value; _p->SOAP_ENV__Subcode = SOAP_ENV__Subcode; } return _p; }

inline void soap_delete_SOAP_ENV__Code(struct soap *soap, struct SOAP_ENV__Code *p) { soap_delete(soap, p); }

SOAP_FMAC3 void SOAP_FMAC4 soap_copy_SOAP_ENV__Code(struct soap*, int, int, void*, size_t, const void*, size_t);

#endif

#ifndef WITH_NOGLOBAL

#ifndef SOAP_TYPE_SOAP_ENV__Header
#define SOAP_TYPE_SOAP_ENV__Header (23)
#endif
SOAP_FMAC3 void SOAP_FMAC4 soap_default_SOAP_ENV__Header(struct soap*, struct SOAP_ENV__Header *);
SOAP_FMAC3 void SOAP_FMAC4 soap_serialize_SOAP_ENV__Header(struct soap*, const struct SOAP_ENV__Header *);
SOAP_FMAC3 int SOAP_FMAC4 soap_out_SOAP_ENV__Header(struct soap*, const char*, int, const struct SOAP_ENV__Header *, const char*);
SOAP_FMAC3 struct SOAP_ENV__Header * SOAP_FMAC4 soap_in_SOAP_ENV__Header(struct soap*, const char*, struct SOAP_ENV__Header *, const char*);

SOAP_FMAC3 int SOAP_FMAC4 soap_put_SOAP_ENV__Header(struct soap*, const struct SOAP_ENV__Header *, const char*, const char*);

#ifndef soap_write_SOAP_ENV__Header
#define soap_write_SOAP_ENV__Header(soap, data) ( soap_serialize_SOAP_ENV__Header(soap, data), soap_begin_send(soap) || soap_put_SOAP_ENV__Header(soap, data, "SOAP-ENV:Header", NULL) || soap_end_send(soap), soap->error )
#endif

SOAP_FMAC3 struct SOAP_ENV__Header * SOAP_FMAC4 soap_get_SOAP_ENV__Header(struct soap*, struct SOAP_ENV__Header *, const char*, const char*);

#ifndef soap_read_SOAP_ENV__Header
#define soap_read_SOAP_ENV__Header(soap, data) ( soap_begin_recv(soap) || !soap_get_SOAP_ENV__Header(soap, data, NULL, NULL) || soap_end_recv(soap), soap->error )
#endif

SOAP_FMAC1 struct SOAP_ENV__Header * SOAP_FMAC2 soap_instantiate_SOAP_ENV__Header(struct soap*, int, const char*, const char*, size_t*);

inline struct SOAP_ENV__Header * soap_new_SOAP_ENV__Header(struct soap *soap, int n = -1) { return soap_instantiate_SOAP_ENV__Header(soap, n, NULL, NULL, NULL); }

inline struct SOAP_ENV__Header * soap_new_req_SOAP_ENV__Header(struct soap *soap) { struct SOAP_ENV__Header *_p = soap_instantiate_SOAP_ENV__Header(soap, -1, NULL, NULL, NULL); if (_p) { soap_default_SOAP_ENV__Header(soap, _p); } return _p; }

inline struct SOAP_ENV__Header * soap_new_set_SOAP_ENV__Header(struct soap *soap) { struct SOAP_ENV__Header *_p = soap_instantiate_SOAP_ENV__Header(soap, -1, NULL, NULL, NULL); if (_p) { soap_default_SOAP_ENV__Header(soap, _p); } return _p; }

inline void soap_delete_SOAP_ENV__Header(struct soap *soap, struct SOAP_ENV__Header *p) { soap_delete(soap, p); }

SOAP_FMAC3 void SOAP_FMAC4 soap_copy_SOAP_ENV__Header(struct soap*, int, int, void*, size_t, const void*, size_t);

#endif

#ifndef SOAP_TYPE_ns__adcReadValue
#define SOAP_TYPE_ns__adcReadValue (22)
#endif
SOAP_FMAC3 void SOAP_FMAC4 soap_default_ns__adcReadValue(struct soap*, struct ns__adcReadValue *);
SOAP_FMAC3 void SOAP_FMAC4 soap_serialize_ns__adcReadValue(struct soap*, const struct ns__adcReadValue *);
SOAP_FMAC3 int SOAP_FMAC4 soap_out_ns__adcReadValue(struct soap*, const char*, int, const struct ns__adcReadValue *, const char*);
SOAP_FMAC3 struct ns__adcReadValue * SOAP_FMAC4 soap_in_ns__adcReadValue(struct soap*, const char*, struct ns__adcReadValue *, const char*);

SOAP_FMAC3 int SOAP_FMAC4 soap_put_ns__adcReadValue(struct soap*, const struct ns__adcReadValue *, const char*, const char*);

#ifndef soap_write_ns__adcReadValue
#define soap_write_ns__adcReadValue(soap, data) ( soap_serialize_ns__adcReadValue(soap, data), soap_begin_send(soap) || soap_put_ns__adcReadValue(soap, data, "ns:adcReadValue", NULL) || soap_end_send(soap), soap->error )
#endif

SOAP_FMAC3 struct ns__adcReadValue * SOAP_FMAC4 soap_get_ns__adcReadValue(struct soap*, struct ns__adcReadValue *, const char*, const char*);

#ifndef soap_read_ns__adcReadValue
#define soap_read_ns__adcReadValue(soap, data) ( soap_begin_recv(soap) || !soap_get_ns__adcReadValue(soap, data, NULL, NULL) || soap_end_recv(soap), soap->error )
#endif

SOAP_FMAC1 struct ns__adcReadValue * SOAP_FMAC2 soap_instantiate_ns__adcReadValue(struct soap*, int, const char*, const char*, size_t*);

inline struct ns__adcReadValue * soap_new_ns__adcReadValue(struct soap *soap, int n = -1) { return soap_instantiate_ns__adcReadValue(soap, n, NULL, NULL, NULL); }

inline struct ns__adcReadValue * soap_new_req_ns__adcReadValue(struct soap *soap) { struct ns__adcReadValue *_p = soap_instantiate_ns__adcReadValue(soap, -1, NULL, NULL, NULL); if (_p) { soap_default_ns__adcReadValue(soap, _p); } return _p; }

inline struct ns__adcReadValue * soap_new_set_ns__adcReadValue(struct soap *soap) { struct ns__adcReadValue *_p = soap_instantiate_ns__adcReadValue(soap, -1, NULL, NULL, NULL); if (_p) { soap_default_ns__adcReadValue(soap, _p); } return _p; }

inline void soap_delete_ns__adcReadValue(struct soap *soap, struct ns__adcReadValue *p) { soap_delete(soap, p); }

SOAP_FMAC3 void SOAP_FMAC4 soap_copy_ns__adcReadValue(struct soap*, int, int, void*, size_t, const void*, size_t);

#ifndef SOAP_TYPE_ns__adcReadValueResponse
#define SOAP_TYPE_ns__adcReadValueResponse (21)
#endif
SOAP_FMAC3 void SOAP_FMAC4 soap_default_ns__adcReadValueResponse(struct soap*, struct ns__adcReadValueResponse *);
SOAP_FMAC3 void SOAP_FMAC4 soap_serialize_ns__adcReadValueResponse(struct soap*, const struct ns__adcReadValueResponse *);
SOAP_FMAC3 int SOAP_FMAC4 soap_out_ns__adcReadValueResponse(struct soap*, const char*, int, const struct ns__adcReadValueResponse *, const char*);
SOAP_FMAC3 struct ns__adcReadValueResponse * SOAP_FMAC4 soap_in_ns__adcReadValueResponse(struct soap*, const char*, struct ns__adcReadValueResponse *, const char*);

SOAP_FMAC3 int SOAP_FMAC4 soap_put_ns__adcReadValueResponse(struct soap*, const struct ns__adcReadValueResponse *, const char*, const char*);

#ifndef soap_write_ns__adcReadValueResponse
#define soap_write_ns__adcReadValueResponse(soap, data) ( soap_serialize_ns__adcReadValueResponse(soap, data), soap_begin_send(soap) || soap_put_ns__adcReadValueResponse(soap, data, "ns:adcReadValueResponse", NULL) || soap_end_send(soap), soap->error )
#endif

SOAP_FMAC3 struct ns__adcReadValueResponse * SOAP_FMAC4 soap_get_ns__adcReadValueResponse(struct soap*, struct ns__adcReadValueResponse *, const char*, const char*);

#ifndef soap_read_ns__adcReadValueResponse
#define soap_read_ns__adcReadValueResponse(soap, data) ( soap_begin_recv(soap) || !soap_get_ns__adcReadValueResponse(soap, data, NULL, NULL) || soap_end_recv(soap), soap->error )
#endif

SOAP_FMAC1 struct ns__adcReadValueResponse * SOAP_FMAC2 soap_instantiate_ns__adcReadValueResponse(struct soap*, int, const char*, const char*, size_t*);

inline struct ns__adcReadValueResponse * soap_new_ns__adcReadValueResponse(struct soap *soap, int n = -1) { return soap_instantiate_ns__adcReadValueResponse(soap, n, NULL, NULL, NULL); }

inline struct ns__adcReadValueResponse * soap_new_req_ns__adcReadValueResponse(struct soap *soap) { struct ns__adcReadValueResponse *_p = soap_instantiate_ns__adcReadValueResponse(soap, -1, NULL, NULL, NULL); if (_p) { soap_default_ns__adcReadValueResponse(soap, _p); } return _p; }

inline struct ns__adcReadValueResponse * soap_new_set_ns__adcReadValueResponse(struct soap *soap, int *result) { struct ns__adcReadValueResponse *_p = soap_instantiate_ns__adcReadValueResponse(soap, -1, NULL, NULL, NULL); if (_p) { soap_default_ns__adcReadValueResponse(soap, _p); _p->result = result; } return _p; }

inline void soap_delete_ns__adcReadValueResponse(struct soap *soap, struct ns__adcReadValueResponse *p) { soap_delete(soap, p); }

SOAP_FMAC3 void SOAP_FMAC4 soap_copy_ns__adcReadValueResponse(struct soap*, int, int, void*, size_t, const void*, size_t);

#ifndef SOAP_TYPE_ns__lm75ReadTemp
#define SOAP_TYPE_ns__lm75ReadTemp (19)
#endif
SOAP_FMAC3 void SOAP_FMAC4 soap_default_ns__lm75ReadTemp(struct soap*, struct ns__lm75ReadTemp *);
SOAP_FMAC3 void SOAP_FMAC4 soap_serialize_ns__lm75ReadTemp(struct soap*, const struct ns__lm75ReadTemp *);
SOAP_FMAC3 int SOAP_FMAC4 soap_out_ns__lm75ReadTemp(struct soap*, const char*, int, const struct ns__lm75ReadTemp *, const char*);
SOAP_FMAC3 struct ns__lm75ReadTemp * SOAP_FMAC4 soap_in_ns__lm75ReadTemp(struct soap*, const char*, struct ns__lm75ReadTemp *, const char*);

SOAP_FMAC3 int SOAP_FMAC4 soap_put_ns__lm75ReadTemp(struct soap*, const struct ns__lm75ReadTemp *, const char*, const char*);

#ifndef soap_write_ns__lm75ReadTemp
#define soap_write_ns__lm75ReadTemp(soap, data) ( soap_serialize_ns__lm75ReadTemp(soap, data), soap_begin_send(soap) || soap_put_ns__lm75ReadTemp(soap, data, "ns:lm75ReadTemp", NULL) || soap_end_send(soap), soap->error )
#endif

SOAP_FMAC3 struct ns__lm75ReadTemp * SOAP_FMAC4 soap_get_ns__lm75ReadTemp(struct soap*, struct ns__lm75ReadTemp *, const char*, const char*);

#ifndef soap_read_ns__lm75ReadTemp
#define soap_read_ns__lm75ReadTemp(soap, data) ( soap_begin_recv(soap) || !soap_get_ns__lm75ReadTemp(soap, data, NULL, NULL) || soap_end_recv(soap), soap->error )
#endif

SOAP_FMAC1 struct ns__lm75ReadTemp * SOAP_FMAC2 soap_instantiate_ns__lm75ReadTemp(struct soap*, int, const char*, const char*, size_t*);

inline struct ns__lm75ReadTemp * soap_new_ns__lm75ReadTemp(struct soap *soap, int n = -1) { return soap_instantiate_ns__lm75ReadTemp(soap, n, NULL, NULL, NULL); }

inline struct ns__lm75ReadTemp * soap_new_req_ns__lm75ReadTemp(struct soap *soap) { struct ns__lm75ReadTemp *_p = soap_instantiate_ns__lm75ReadTemp(soap, -1, NULL, NULL, NULL); if (_p) { soap_default_ns__lm75ReadTemp(soap, _p); } return _p; }

inline struct ns__lm75ReadTemp * soap_new_set_ns__lm75ReadTemp(struct soap *soap) { struct ns__lm75ReadTemp *_p = soap_instantiate_ns__lm75ReadTemp(soap, -1, NULL, NULL, NULL); if (_p) { soap_default_ns__lm75ReadTemp(soap, _p); } return _p; }

inline void soap_delete_ns__lm75ReadTemp(struct soap *soap, struct ns__lm75ReadTemp *p) { soap_delete(soap, p); }

SOAP_FMAC3 void SOAP_FMAC4 soap_copy_ns__lm75ReadTemp(struct soap*, int, int, void*, size_t, const void*, size_t);

#ifndef SOAP_TYPE_ns__lm75ReadTempResponse
#define SOAP_TYPE_ns__lm75ReadTempResponse (18)
#endif
SOAP_FMAC3 void SOAP_FMAC4 soap_default_ns__lm75ReadTempResponse(struct soap*, struct ns__lm75ReadTempResponse *);
SOAP_FMAC3 void SOAP_FMAC4 soap_serialize_ns__lm75ReadTempResponse(struct soap*, const struct ns__lm75ReadTempResponse *);
SOAP_FMAC3 int SOAP_FMAC4 soap_out_ns__lm75ReadTempResponse(struct soap*, const char*, int, const struct ns__lm75ReadTempResponse *, const char*);
SOAP_FMAC3 struct ns__lm75ReadTempResponse * SOAP_FMAC4 soap_in_ns__lm75ReadTempResponse(struct soap*, const char*, struct ns__lm75ReadTempResponse *, const char*);

SOAP_FMAC3 int SOAP_FMAC4 soap_put_ns__lm75ReadTempResponse(struct soap*, const struct ns__lm75ReadTempResponse *, const char*, const char*);

#ifndef soap_write_ns__lm75ReadTempResponse
#define soap_write_ns__lm75ReadTempResponse(soap, data) ( soap_serialize_ns__lm75ReadTempResponse(soap, data), soap_begin_send(soap) || soap_put_ns__lm75ReadTempResponse(soap, data, "ns:lm75ReadTempResponse", NULL) || soap_end_send(soap), soap->error )
#endif

SOAP_FMAC3 struct ns__lm75ReadTempResponse * SOAP_FMAC4 soap_get_ns__lm75ReadTempResponse(struct soap*, struct ns__lm75ReadTempResponse *, const char*, const char*);

#ifndef soap_read_ns__lm75ReadTempResponse
#define soap_read_ns__lm75ReadTempResponse(soap, data) ( soap_begin_recv(soap) || !soap_get_ns__lm75ReadTempResponse(soap, data, NULL, NULL) || soap_end_recv(soap), soap->error )
#endif

SOAP_FMAC1 struct ns__lm75ReadTempResponse * SOAP_FMAC2 soap_instantiate_ns__lm75ReadTempResponse(struct soap*, int, const char*, const char*, size_t*);

inline struct ns__lm75ReadTempResponse * soap_new_ns__lm75ReadTempResponse(struct soap *soap, int n = -1) { return soap_instantiate_ns__lm75ReadTempResponse(soap, n, NULL, NULL, NULL); }

inline struct ns__lm75ReadTempResponse * soap_new_req_ns__lm75ReadTempResponse(struct soap *soap) { struct ns__lm75ReadTempResponse *_p = soap_instantiate_ns__lm75ReadTempResponse(soap, -1, NULL, NULL, NULL); if (_p) { soap_default_ns__lm75ReadTempResponse(soap, _p); } return _p; }

inline struct ns__lm75ReadTempResponse * soap_new_set_ns__lm75ReadTempResponse(struct soap *soap, int *result) { struct ns__lm75ReadTempResponse *_p = soap_instantiate_ns__lm75ReadTempResponse(soap, -1, NULL, NULL, NULL); if (_p) { soap_default_ns__lm75ReadTempResponse(soap, _p); _p->result = result; } return _p; }

inline void soap_delete_ns__lm75ReadTempResponse(struct soap *soap, struct ns__lm75ReadTempResponse *p) { soap_delete(soap, p); }

SOAP_FMAC3 void SOAP_FMAC4 soap_copy_ns__lm75ReadTempResponse(struct soap*, int, int, void*, size_t, const void*, size_t);

#ifndef SOAP_TYPE_ns__spiReadId
#define SOAP_TYPE_ns__spiReadId (16)
#endif
SOAP_FMAC3 void SOAP_FMAC4 soap_default_ns__spiReadId(struct soap*, struct ns__spiReadId *);
SOAP_FMAC3 void SOAP_FMAC4 soap_serialize_ns__spiReadId(struct soap*, const struct ns__spiReadId *);
SOAP_FMAC3 int SOAP_FMAC4 soap_out_ns__spiReadId(struct soap*, const char*, int, const struct ns__spiReadId *, const char*);
SOAP_FMAC3 struct ns__spiReadId * SOAP_FMAC4 soap_in_ns__spiReadId(struct soap*, const char*, struct ns__spiReadId *, const char*);

SOAP_FMAC3 int SOAP_FMAC4 soap_put_ns__spiReadId(struct soap*, const struct ns__spiReadId *, const char*, const char*);

#ifndef soap_write_ns__spiReadId
#define soap_write_ns__spiReadId(soap, data) ( soap_serialize_ns__spiReadId(soap, data), soap_begin_send(soap) || soap_put_ns__spiReadId(soap, data, "ns:spiReadId", NULL) || soap_end_send(soap), soap->error )
#endif

SOAP_FMAC3 struct ns__spiReadId * SOAP_FMAC4 soap_get_ns__spiReadId(struct soap*, struct ns__spiReadId *, const char*, const char*);

#ifndef soap_read_ns__spiReadId
#define soap_read_ns__spiReadId(soap, data) ( soap_begin_recv(soap) || !soap_get_ns__spiReadId(soap, data, NULL, NULL) || soap_end_recv(soap), soap->error )
#endif

SOAP_FMAC1 struct ns__spiReadId * SOAP_FMAC2 soap_instantiate_ns__spiReadId(struct soap*, int, const char*, const char*, size_t*);

inline struct ns__spiReadId * soap_new_ns__spiReadId(struct soap *soap, int n = -1) { return soap_instantiate_ns__spiReadId(soap, n, NULL, NULL, NULL); }

inline struct ns__spiReadId * soap_new_req_ns__spiReadId(struct soap *soap) { struct ns__spiReadId *_p = soap_instantiate_ns__spiReadId(soap, -1, NULL, NULL, NULL); if (_p) { soap_default_ns__spiReadId(soap, _p); } return _p; }

inline struct ns__spiReadId * soap_new_set_ns__spiReadId(struct soap *soap) { struct ns__spiReadId *_p = soap_instantiate_ns__spiReadId(soap, -1, NULL, NULL, NULL); if (_p) { soap_default_ns__spiReadId(soap, _p); } return _p; }

inline void soap_delete_ns__spiReadId(struct soap *soap, struct ns__spiReadId *p) { soap_delete(soap, p); }

SOAP_FMAC3 void SOAP_FMAC4 soap_copy_ns__spiReadId(struct soap*, int, int, void*, size_t, const void*, size_t);

#ifndef SOAP_TYPE_ns__spiReadIdResponse
#define SOAP_TYPE_ns__spiReadIdResponse (15)
#endif
SOAP_FMAC3 void SOAP_FMAC4 soap_default_ns__spiReadIdResponse(struct soap*, struct ns__spiReadIdResponse *);
SOAP_FMAC3 void SOAP_FMAC4 soap_serialize_ns__spiReadIdResponse(struct soap*, const struct ns__spiReadIdResponse *);
SOAP_FMAC3 int SOAP_FMAC4 soap_out_ns__spiReadIdResponse(struct soap*, const char*, int, const struct ns__spiReadIdResponse *, const char*);
SOAP_FMAC3 struct ns__spiReadIdResponse * SOAP_FMAC4 soap_in_ns__spiReadIdResponse(struct soap*, const char*, struct ns__spiReadIdResponse *, const char*);

SOAP_FMAC3 int SOAP_FMAC4 soap_put_ns__spiReadIdResponse(struct soap*, const struct ns__spiReadIdResponse *, const char*, const char*);

#ifndef soap_write_ns__spiReadIdResponse
#define soap_write_ns__spiReadIdResponse(soap, data) ( soap_serialize_ns__spiReadIdResponse(soap, data), soap_begin_send(soap) || soap_put_ns__spiReadIdResponse(soap, data, "ns:spiReadIdResponse", NULL) || soap_end_send(soap), soap->error )
#endif

SOAP_FMAC3 struct ns__spiReadIdResponse * SOAP_FMAC4 soap_get_ns__spiReadIdResponse(struct soap*, struct ns__spiReadIdResponse *, const char*, const char*);

#ifndef soap_read_ns__spiReadIdResponse
#define soap_read_ns__spiReadIdResponse(soap, data) ( soap_begin_recv(soap) || !soap_get_ns__spiReadIdResponse(soap, data, NULL, NULL) || soap_end_recv(soap), soap->error )
#endif

SOAP_FMAC1 struct ns__spiReadIdResponse * SOAP_FMAC2 soap_instantiate_ns__spiReadIdResponse(struct soap*, int, const char*, const char*, size_t*);

inline struct ns__spiReadIdResponse * soap_new_ns__spiReadIdResponse(struct soap *soap, int n = -1) { return soap_instantiate_ns__spiReadIdResponse(soap, n, NULL, NULL, NULL); }

inline struct ns__spiReadIdResponse * soap_new_req_ns__spiReadIdResponse(struct soap *soap) { struct ns__spiReadIdResponse *_p = soap_instantiate_ns__spiReadIdResponse(soap, -1, NULL, NULL, NULL); if (_p) { soap_default_ns__spiReadIdResponse(soap, _p); } return _p; }

inline struct ns__spiReadIdResponse * soap_new_set_ns__spiReadIdResponse(struct soap *soap, int *result) { struct ns__spiReadIdResponse *_p = soap_instantiate_ns__spiReadIdResponse(soap, -1, NULL, NULL, NULL); if (_p) { soap_default_ns__spiReadIdResponse(soap, _p); _p->result = result; } return _p; }

inline void soap_delete_ns__spiReadIdResponse(struct soap *soap, struct ns__spiReadIdResponse *p) { soap_delete(soap, p); }

SOAP_FMAC3 void SOAP_FMAC4 soap_copy_ns__spiReadIdResponse(struct soap*, int, int, void*, size_t, const void*, size_t);

#ifndef SOAP_TYPE_ns__motorControl
#define SOAP_TYPE_ns__motorControl (13)
#endif
SOAP_FMAC3 void SOAP_FMAC4 soap_default_ns__motorControl(struct soap*, struct ns__motorControl *);
SOAP_FMAC3 void SOAP_FMAC4 soap_serialize_ns__motorControl(struct soap*, const struct ns__motorControl *);
SOAP_FMAC3 int SOAP_FMAC4 soap_out_ns__motorControl(struct soap*, const char*, int, const struct ns__motorControl *, const char*);
SOAP_FMAC3 struct ns__motorControl * SOAP_FMAC4 soap_in_ns__motorControl(struct soap*, const char*, struct ns__motorControl *, const char*);

SOAP_FMAC3 int SOAP_FMAC4 soap_put_ns__motorControl(struct soap*, const struct ns__motorControl *, const char*, const char*);

#ifndef soap_write_ns__motorControl
#define soap_write_ns__motorControl(soap, data) ( soap_serialize_ns__motorControl(soap, data), soap_begin_send(soap) || soap_put_ns__motorControl(soap, data, "ns:motorControl", NULL) || soap_end_send(soap), soap->error )
#endif

SOAP_FMAC3 struct ns__motorControl * SOAP_FMAC4 soap_get_ns__motorControl(struct soap*, struct ns__motorControl *, const char*, const char*);

#ifndef soap_read_ns__motorControl
#define soap_read_ns__motorControl(soap, data) ( soap_begin_recv(soap) || !soap_get_ns__motorControl(soap, data, NULL, NULL) || soap_end_recv(soap), soap->error )
#endif

SOAP_FMAC1 struct ns__motorControl * SOAP_FMAC2 soap_instantiate_ns__motorControl(struct soap*, int, const char*, const char*, size_t*);

inline struct ns__motorControl * soap_new_ns__motorControl(struct soap *soap, int n = -1) { return soap_instantiate_ns__motorControl(soap, n, NULL, NULL, NULL); }

inline struct ns__motorControl * soap_new_req_ns__motorControl(struct soap *soap, int motor_id, int motor_op) { struct ns__motorControl *_p = soap_instantiate_ns__motorControl(soap, -1, NULL, NULL, NULL); if (_p) { soap_default_ns__motorControl(soap, _p); _p->motor_id = motor_id; _p->motor_op = motor_op; } return _p; }

inline struct ns__motorControl * soap_new_set_ns__motorControl(struct soap *soap, int motor_id, int motor_op) { struct ns__motorControl *_p = soap_instantiate_ns__motorControl(soap, -1, NULL, NULL, NULL); if (_p) { soap_default_ns__motorControl(soap, _p); _p->motor_id = motor_id; _p->motor_op = motor_op; } return _p; }

inline void soap_delete_ns__motorControl(struct soap *soap, struct ns__motorControl *p) { soap_delete(soap, p); }

SOAP_FMAC3 void SOAP_FMAC4 soap_copy_ns__motorControl(struct soap*, int, int, void*, size_t, const void*, size_t);

#ifndef SOAP_TYPE_ns__motorControlResponse
#define SOAP_TYPE_ns__motorControlResponse (12)
#endif
SOAP_FMAC3 void SOAP_FMAC4 soap_default_ns__motorControlResponse(struct soap*, struct ns__motorControlResponse *);
SOAP_FMAC3 void SOAP_FMAC4 soap_serialize_ns__motorControlResponse(struct soap*, const struct ns__motorControlResponse *);
SOAP_FMAC3 int SOAP_FMAC4 soap_out_ns__motorControlResponse(struct soap*, const char*, int, const struct ns__motorControlResponse *, const char*);
SOAP_FMAC3 struct ns__motorControlResponse * SOAP_FMAC4 soap_in_ns__motorControlResponse(struct soap*, const char*, struct ns__motorControlResponse *, const char*);

SOAP_FMAC3 int SOAP_FMAC4 soap_put_ns__motorControlResponse(struct soap*, const struct ns__motorControlResponse *, const char*, const char*);

#ifndef soap_write_ns__motorControlResponse
#define soap_write_ns__motorControlResponse(soap, data) ( soap_serialize_ns__motorControlResponse(soap, data), soap_begin_send(soap) || soap_put_ns__motorControlResponse(soap, data, "ns:motorControlResponse", NULL) || soap_end_send(soap), soap->error )
#endif

SOAP_FMAC3 struct ns__motorControlResponse * SOAP_FMAC4 soap_get_ns__motorControlResponse(struct soap*, struct ns__motorControlResponse *, const char*, const char*);

#ifndef soap_read_ns__motorControlResponse
#define soap_read_ns__motorControlResponse(soap, data) ( soap_begin_recv(soap) || !soap_get_ns__motorControlResponse(soap, data, NULL, NULL) || soap_end_recv(soap), soap->error )
#endif

SOAP_FMAC1 struct ns__motorControlResponse * SOAP_FMAC2 soap_instantiate_ns__motorControlResponse(struct soap*, int, const char*, const char*, size_t*);

inline struct ns__motorControlResponse * soap_new_ns__motorControlResponse(struct soap *soap, int n = -1) { return soap_instantiate_ns__motorControlResponse(soap, n, NULL, NULL, NULL); }

inline struct ns__motorControlResponse * soap_new_req_ns__motorControlResponse(struct soap *soap) { struct ns__motorControlResponse *_p = soap_instantiate_ns__motorControlResponse(soap, -1, NULL, NULL, NULL); if (_p) { soap_default_ns__motorControlResponse(soap, _p); } return _p; }

inline struct ns__motorControlResponse * soap_new_set_ns__motorControlResponse(struct soap *soap, int *result) { struct ns__motorControlResponse *_p = soap_instantiate_ns__motorControlResponse(soap, -1, NULL, NULL, NULL); if (_p) { soap_default_ns__motorControlResponse(soap, _p); _p->result = result; } return _p; }

inline void soap_delete_ns__motorControlResponse(struct soap *soap, struct ns__motorControlResponse *p) { soap_delete(soap, p); }

SOAP_FMAC3 void SOAP_FMAC4 soap_copy_ns__motorControlResponse(struct soap*, int, int, void*, size_t, const void*, size_t);

#ifndef SOAP_TYPE_ns__ledControl
#define SOAP_TYPE_ns__ledControl (10)
#endif
SOAP_FMAC3 void SOAP_FMAC4 soap_default_ns__ledControl(struct soap*, struct ns__ledControl *);
SOAP_FMAC3 void SOAP_FMAC4 soap_serialize_ns__ledControl(struct soap*, const struct ns__ledControl *);
SOAP_FMAC3 int SOAP_FMAC4 soap_out_ns__ledControl(struct soap*, const char*, int, const struct ns__ledControl *, const char*);
SOAP_FMAC3 struct ns__ledControl * SOAP_FMAC4 soap_in_ns__ledControl(struct soap*, const char*, struct ns__ledControl *, const char*);

SOAP_FMAC3 int SOAP_FMAC4 soap_put_ns__ledControl(struct soap*, const struct ns__ledControl *, const char*, const char*);

#ifndef soap_write_ns__ledControl
#define soap_write_ns__ledControl(soap, data) ( soap_serialize_ns__ledControl(soap, data), soap_begin_send(soap) || soap_put_ns__ledControl(soap, data, "ns:ledControl", NULL) || soap_end_send(soap), soap->error )
#endif

SOAP_FMAC3 struct ns__ledControl * SOAP_FMAC4 soap_get_ns__ledControl(struct soap*, struct ns__ledControl *, const char*, const char*);

#ifndef soap_read_ns__ledControl
#define soap_read_ns__ledControl(soap, data) ( soap_begin_recv(soap) || !soap_get_ns__ledControl(soap, data, NULL, NULL) || soap_end_recv(soap), soap->error )
#endif

SOAP_FMAC1 struct ns__ledControl * SOAP_FMAC2 soap_instantiate_ns__ledControl(struct soap*, int, const char*, const char*, size_t*);

inline struct ns__ledControl * soap_new_ns__ledControl(struct soap *soap, int n = -1) { return soap_instantiate_ns__ledControl(soap, n, NULL, NULL, NULL); }

inline struct ns__ledControl * soap_new_req_ns__ledControl(struct soap *soap, int led_id, int led_stat) { struct ns__ledControl *_p = soap_instantiate_ns__ledControl(soap, -1, NULL, NULL, NULL); if (_p) { soap_default_ns__ledControl(soap, _p); _p->led_id = led_id; _p->led_stat = led_stat; } return _p; }

inline struct ns__ledControl * soap_new_set_ns__ledControl(struct soap *soap, int led_id, int led_stat) { struct ns__ledControl *_p = soap_instantiate_ns__ledControl(soap, -1, NULL, NULL, NULL); if (_p) { soap_default_ns__ledControl(soap, _p); _p->led_id = led_id; _p->led_stat = led_stat; } return _p; }

inline void soap_delete_ns__ledControl(struct soap *soap, struct ns__ledControl *p) { soap_delete(soap, p); }

SOAP_FMAC3 void SOAP_FMAC4 soap_copy_ns__ledControl(struct soap*, int, int, void*, size_t, const void*, size_t);

#ifndef SOAP_TYPE_ns__ledControlResponse
#define SOAP_TYPE_ns__ledControlResponse (9)
#endif
SOAP_FMAC3 void SOAP_FMAC4 soap_default_ns__ledControlResponse(struct soap*, struct ns__ledControlResponse *);
SOAP_FMAC3 void SOAP_FMAC4 soap_serialize_ns__ledControlResponse(struct soap*, const struct ns__ledControlResponse *);
SOAP_FMAC3 int SOAP_FMAC4 soap_out_ns__ledControlResponse(struct soap*, const char*, int, const struct ns__ledControlResponse *, const char*);
SOAP_FMAC3 struct ns__ledControlResponse * SOAP_FMAC4 soap_in_ns__ledControlResponse(struct soap*, const char*, struct ns__ledControlResponse *, const char*);

SOAP_FMAC3 int SOAP_FMAC4 soap_put_ns__ledControlResponse(struct soap*, const struct ns__ledControlResponse *, const char*, const char*);

#ifndef soap_write_ns__ledControlResponse
#define soap_write_ns__ledControlResponse(soap, data) ( soap_serialize_ns__ledControlResponse(soap, data), soap_begin_send(soap) || soap_put_ns__ledControlResponse(soap, data, "ns:ledControlResponse", NULL) || soap_end_send(soap), soap->error )
#endif

SOAP_FMAC3 struct ns__ledControlResponse * SOAP_FMAC4 soap_get_ns__ledControlResponse(struct soap*, struct ns__ledControlResponse *, const char*, const char*);

#ifndef soap_read_ns__ledControlResponse
#define soap_read_ns__ledControlResponse(soap, data) ( soap_begin_recv(soap) || !soap_get_ns__ledControlResponse(soap, data, NULL, NULL) || soap_end_recv(soap), soap->error )
#endif

SOAP_FMAC1 struct ns__ledControlResponse * SOAP_FMAC2 soap_instantiate_ns__ledControlResponse(struct soap*, int, const char*, const char*, size_t*);

inline struct ns__ledControlResponse * soap_new_ns__ledControlResponse(struct soap *soap, int n = -1) { return soap_instantiate_ns__ledControlResponse(soap, n, NULL, NULL, NULL); }

inline struct ns__ledControlResponse * soap_new_req_ns__ledControlResponse(struct soap *soap) { struct ns__ledControlResponse *_p = soap_instantiate_ns__ledControlResponse(soap, -1, NULL, NULL, NULL); if (_p) { soap_default_ns__ledControlResponse(soap, _p); } return _p; }

inline struct ns__ledControlResponse * soap_new_set_ns__ledControlResponse(struct soap *soap, int *result) { struct ns__ledControlResponse *_p = soap_instantiate_ns__ledControlResponse(soap, -1, NULL, NULL, NULL); if (_p) { soap_default_ns__ledControlResponse(soap, _p); _p->result = result; } return _p; }

inline void soap_delete_ns__ledControlResponse(struct soap *soap, struct ns__ledControlResponse *p) { soap_delete(soap, p); }

SOAP_FMAC3 void SOAP_FMAC4 soap_copy_ns__ledControlResponse(struct soap*, int, int, void*, size_t, const void*, size_t);

#ifndef WITH_NOGLOBAL

#ifndef SOAP_TYPE_PointerToSOAP_ENV__Reason
#define SOAP_TYPE_PointerToSOAP_ENV__Reason (32)
#endif
SOAP_FMAC3 void SOAP_FMAC4 soap_serialize_PointerToSOAP_ENV__Reason(struct soap*, struct SOAP_ENV__Reason *const*);
SOAP_FMAC3 int SOAP_FMAC4 soap_out_PointerToSOAP_ENV__Reason(struct soap*, const char *, int, struct SOAP_ENV__Reason *const*, const char *);
SOAP_FMAC3 struct SOAP_ENV__Reason ** SOAP_FMAC4 soap_in_PointerToSOAP_ENV__Reason(struct soap*, const char*, struct SOAP_ENV__Reason **, const char*);
SOAP_FMAC3 int SOAP_FMAC4 soap_put_PointerToSOAP_ENV__Reason(struct soap*, struct SOAP_ENV__Reason *const*, const char*, const char*);

#ifndef soap_write_PointerToSOAP_ENV__Reason
#define soap_write_PointerToSOAP_ENV__Reason(soap, data) ( soap_serialize_PointerToSOAP_ENV__Reason(soap, data), soap_begin_send(soap) || soap_put_PointerToSOAP_ENV__Reason(soap, data, "SOAP-ENV:Reason", NULL) || soap_end_send(soap), soap->error )
#endif

SOAP_FMAC3 struct SOAP_ENV__Reason ** SOAP_FMAC4 soap_get_PointerToSOAP_ENV__Reason(struct soap*, struct SOAP_ENV__Reason **, const char*, const char*);

#ifndef soap_read_PointerToSOAP_ENV__Reason
#define soap_read_PointerToSOAP_ENV__Reason(soap, data) ( soap_begin_recv(soap) || !soap_get_PointerToSOAP_ENV__Reason(soap, data, NULL, NULL) || soap_end_recv(soap), soap->error )
#endif


#endif

#ifndef WITH_NOGLOBAL

#ifndef SOAP_TYPE_PointerToSOAP_ENV__Detail
#define SOAP_TYPE_PointerToSOAP_ENV__Detail (31)
#endif
SOAP_FMAC3 void SOAP_FMAC4 soap_serialize_PointerToSOAP_ENV__Detail(struct soap*, struct SOAP_ENV__Detail *const*);
SOAP_FMAC3 int SOAP_FMAC4 soap_out_PointerToSOAP_ENV__Detail(struct soap*, const char *, int, struct SOAP_ENV__Detail *const*, const char *);
SOAP_FMAC3 struct SOAP_ENV__Detail ** SOAP_FMAC4 soap_in_PointerToSOAP_ENV__Detail(struct soap*, const char*, struct SOAP_ENV__Detail **, const char*);
SOAP_FMAC3 int SOAP_FMAC4 soap_put_PointerToSOAP_ENV__Detail(struct soap*, struct SOAP_ENV__Detail *const*, const char*, const char*);

#ifndef soap_write_PointerToSOAP_ENV__Detail
#define soap_write_PointerToSOAP_ENV__Detail(soap, data) ( soap_serialize_PointerToSOAP_ENV__Detail(soap, data), soap_begin_send(soap) || soap_put_PointerToSOAP_ENV__Detail(soap, data, "SOAP-ENV:Detail", NULL) || soap_end_send(soap), soap->error )
#endif

SOAP_FMAC3 struct SOAP_ENV__Detail ** SOAP_FMAC4 soap_get_PointerToSOAP_ENV__Detail(struct soap*, struct SOAP_ENV__Detail **, const char*, const char*);

#ifndef soap_read_PointerToSOAP_ENV__Detail
#define soap_read_PointerToSOAP_ENV__Detail(soap, data) ( soap_begin_recv(soap) || !soap_get_PointerToSOAP_ENV__Detail(soap, data, NULL, NULL) || soap_end_recv(soap), soap->error )
#endif


#endif

#ifndef WITH_NOGLOBAL

#ifndef SOAP_TYPE_PointerToSOAP_ENV__Code
#define SOAP_TYPE_PointerToSOAP_ENV__Code (25)
#endif
SOAP_FMAC3 void SOAP_FMAC4 soap_serialize_PointerToSOAP_ENV__Code(struct soap*, struct SOAP_ENV__Code *const*);
SOAP_FMAC3 int SOAP_FMAC4 soap_out_PointerToSOAP_ENV__Code(struct soap*, const char *, int, struct SOAP_ENV__Code *const*, const char *);
SOAP_FMAC3 struct SOAP_ENV__Code ** SOAP_FMAC4 soap_in_PointerToSOAP_ENV__Code(struct soap*, const char*, struct SOAP_ENV__Code **, const char*);
SOAP_FMAC3 int SOAP_FMAC4 soap_put_PointerToSOAP_ENV__Code(struct soap*, struct SOAP_ENV__Code *const*, const char*, const char*);

#ifndef soap_write_PointerToSOAP_ENV__Code
#define soap_write_PointerToSOAP_ENV__Code(soap, data) ( soap_serialize_PointerToSOAP_ENV__Code(soap, data), soap_begin_send(soap) || soap_put_PointerToSOAP_ENV__Code(soap, data, "SOAP-ENV:Code", NULL) || soap_end_send(soap), soap->error )
#endif

SOAP_FMAC3 struct SOAP_ENV__Code ** SOAP_FMAC4 soap_get_PointerToSOAP_ENV__Code(struct soap*, struct SOAP_ENV__Code **, const char*, const char*);

#ifndef soap_read_PointerToSOAP_ENV__Code
#define soap_read_PointerToSOAP_ENV__Code(soap, data) ( soap_begin_recv(soap) || !soap_get_PointerToSOAP_ENV__Code(soap, data, NULL, NULL) || soap_end_recv(soap), soap->error )
#endif


#endif

#ifndef SOAP_TYPE_PointerToint
#define SOAP_TYPE_PointerToint (7)
#endif
SOAP_FMAC3 void SOAP_FMAC4 soap_serialize_PointerToint(struct soap*, int *const*);
SOAP_FMAC3 int SOAP_FMAC4 soap_out_PointerToint(struct soap*, const char *, int, int *const*, const char *);
SOAP_FMAC3 int ** SOAP_FMAC4 soap_in_PointerToint(struct soap*, const char*, int **, const char*);
SOAP_FMAC3 int SOAP_FMAC4 soap_put_PointerToint(struct soap*, int *const*, const char*, const char*);

#ifndef soap_write_PointerToint
#define soap_write_PointerToint(soap, data) ( soap_serialize_PointerToint(soap, data), soap_begin_send(soap) || soap_put_PointerToint(soap, data, "int", NULL) || soap_end_send(soap), soap->error )
#endif

SOAP_FMAC3 int ** SOAP_FMAC4 soap_get_PointerToint(struct soap*, int **, const char*, const char*);

#ifndef soap_read_PointerToint
#define soap_read_PointerToint(soap, data) ( soap_begin_recv(soap) || !soap_get_PointerToint(soap, data, NULL, NULL) || soap_end_recv(soap), soap->error )
#endif


#ifndef SOAP_TYPE__QName
#define SOAP_TYPE__QName (5)
#endif

#define soap_default__QName(soap, a) soap_default_string(soap, a)

SOAP_FMAC3 void SOAP_FMAC4 soap_serialize__QName(struct soap*, char *const*);
SOAP_FMAC3 int SOAP_FMAC4 soap_out__QName(struct soap*, const char*, int, char*const*, const char*);
SOAP_FMAC3 char * * SOAP_FMAC4 soap_in__QName(struct soap*, const char*, char **, const char*);
SOAP_FMAC3 int SOAP_FMAC4 soap_put__QName(struct soap*, char *const*, const char*, const char*);

#ifndef soap_write__QName
#define soap_write__QName(soap, data) ( soap_serialize__QName(soap, data), soap_begin_send(soap) || soap_put__QName(soap, data, "byte", NULL) || soap_end_send(soap), soap->error )
#endif

SOAP_FMAC3 char ** SOAP_FMAC4 soap_get__QName(struct soap*, char **, const char*, const char*);

#ifndef soap_read__QName
#define soap_read__QName(soap, data) ( soap_begin_recv(soap) || !soap_get__QName(soap, data, NULL, NULL) || soap_end_recv(soap), soap->error )
#endif


#ifndef SOAP_TYPE_string
#define SOAP_TYPE_string (4)
#endif
SOAP_FMAC3 void SOAP_FMAC4 soap_default_string(struct soap*, char **);
SOAP_FMAC3 void SOAP_FMAC4 soap_serialize_string(struct soap*, char *const*);
SOAP_FMAC3 int SOAP_FMAC4 soap_out_string(struct soap*, const char*, int, char*const*, const char*);
SOAP_FMAC3 char * * SOAP_FMAC4 soap_in_string(struct soap*, const char*, char **, const char*);
SOAP_FMAC3 int SOAP_FMAC4 soap_put_string(struct soap*, char *const*, const char*, const char*);

#ifndef soap_write_string
#define soap_write_string(soap, data) ( soap_serialize_string(soap, data), soap_begin_send(soap) || soap_put_string(soap, data, "byte", NULL) || soap_end_send(soap), soap->error )
#endif

SOAP_FMAC3 char ** SOAP_FMAC4 soap_get_string(struct soap*, char **, const char*, const char*);

#ifndef soap_read_string
#define soap_read_string(soap, data) ( soap_begin_recv(soap) || !soap_get_string(soap, data, NULL, NULL) || soap_end_recv(soap), soap->error )
#endif


#endif

/* End of soapH.h */
