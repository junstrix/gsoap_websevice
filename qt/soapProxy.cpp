/* soapProxy.cpp
   Generated by gSOAP 2.8.15 from gsoapControl.h

Copyright(C) 2000-2013, Robert van Engelen, Genivia Inc. All Rights Reserved.
The generated code is released under ONE of the following licenses:
GPL or Genivia's license for commercial use.
This program is released under the GPL with the additional exemption that
compiling, linking, and/or using OpenSSL is allowed.
*/

#include "soapProxy.h"

Proxy::Proxy()
{	Proxy_init(SOAP_IO_DEFAULT, SOAP_IO_DEFAULT);
}

Proxy::Proxy(const struct soap &_soap) : soap(_soap)
{ }

Proxy::Proxy(const char *url)
{	Proxy_init(SOAP_IO_DEFAULT, SOAP_IO_DEFAULT);
	soap_endpoint = url;
}

Proxy::Proxy(soap_mode iomode)
{	Proxy_init(iomode, iomode);
}

Proxy::Proxy(const char *url, soap_mode iomode)
{	Proxy_init(iomode, iomode);
	soap_endpoint = url;
}

Proxy::Proxy(soap_mode imode, soap_mode omode)
{	Proxy_init(imode, omode);
}

Proxy::~Proxy()
{ }

void Proxy::Proxy_init(soap_mode imode, soap_mode omode)
{	soap_imode(this, imode);
	soap_omode(this, omode);
	soap_endpoint = NULL;
	static const struct Namespace namespaces[] =
{
	{"SOAP-ENV", "http://schemas.xmlsoap.org/soap/envelope/", "http://www.w3.org/*/soap-envelope", NULL},
	{"SOAP-ENC", "http://schemas.xmlsoap.org/soap/encoding/", "http://www.w3.org/*/soap-encoding", NULL},
	{"xsi", "http://www.w3.org/2001/XMLSchema-instance", "http://www.w3.org/*/XMLSchema-instance", NULL},
	{"xsd", "http://www.w3.org/2001/XMLSchema", "http://www.w3.org/*/XMLSchema", NULL},
	{"ns", "http://tempuri.org/ns.xsd", NULL, NULL},
	{NULL, NULL, NULL, NULL}
};
	soap_set_namespaces(this, namespaces);
}

void Proxy::destroy()
{	soap_destroy(this);
	soap_end(this);
}

void Proxy::reset()
{	destroy();
	soap_done(this);
	soap_init(this);
	Proxy_init(SOAP_IO_DEFAULT, SOAP_IO_DEFAULT);
}

void Proxy::soap_noheader()
{	this->header = NULL;
}

const SOAP_ENV__Header *Proxy::soap_header()
{	return this->header;
}

const SOAP_ENV__Fault *Proxy::soap_fault()
{	return this->fault;
}

const char *Proxy::soap_fault_string()
{	return *soap_faultstring(this);
}

const char *Proxy::soap_fault_detail()
{	return *soap_faultdetail(this);
}

int Proxy::soap_close_socket()
{	return soap_closesock(this);
}

int Proxy::soap_force_close_socket()
{	return soap_force_closesock(this);
}

void Proxy::soap_print_fault(FILE *fd)
{	::soap_print_fault(this, fd);
}

#ifndef WITH_LEAN
#ifndef WITH_COMPAT
void Proxy::soap_stream_fault(std::ostream& os)
{	::soap_stream_fault(this, os);
}
#endif

char *Proxy::soap_sprint_fault(char *buf, size_t len)
{	return ::soap_sprint_fault(this, buf, len);
}
#endif

int Proxy::ledControl(const char *endpoint, const char *soap_action, int led_id, int led_stat, int *result)
{	struct soap *soap = this;
	struct ns__ledControl soap_tmp_ns__ledControl;
	struct ns__ledControlResponse *soap_tmp_ns__ledControlResponse;
	if (endpoint)
		soap_endpoint = endpoint;
	soap->encodingStyle = NULL;
	soap_tmp_ns__ledControl.led_id = led_id;
	soap_tmp_ns__ledControl.led_stat = led_stat;
	soap_begin(soap);
	soap_serializeheader(soap);
	soap_serialize_ns__ledControl(soap, &soap_tmp_ns__ledControl);
	if (soap_begin_count(soap))
		return soap->error;
	if (soap->mode & SOAP_IO_LENGTH)
	{	if (soap_envelope_begin_out(soap)
		 || soap_putheader(soap)
		 || soap_body_begin_out(soap)
		 || soap_put_ns__ledControl(soap, &soap_tmp_ns__ledControl, "ns:ledControl", NULL)
		 || soap_body_end_out(soap)
		 || soap_envelope_end_out(soap))
			 return soap->error;
	}
	if (soap_end_count(soap))
		return soap->error;
	if (soap_connect(soap, soap_url(soap, soap_endpoint, NULL), soap_action)
	 || soap_envelope_begin_out(soap)
	 || soap_putheader(soap)
	 || soap_body_begin_out(soap)
	 || soap_put_ns__ledControl(soap, &soap_tmp_ns__ledControl, "ns:ledControl", NULL)
	 || soap_body_end_out(soap)
	 || soap_envelope_end_out(soap)
	 || soap_end_send(soap))
		return soap_closesock(soap);
	if (!result)
		return soap_closesock(soap);
	soap_default_int(soap, result);
	if (soap_begin_recv(soap)
	 || soap_envelope_begin_in(soap)
	 || soap_recv_header(soap)
	 || soap_body_begin_in(soap))
		return soap_closesock(soap);
	soap_tmp_ns__ledControlResponse = soap_get_ns__ledControlResponse(soap, NULL, "ns:ledControlResponse", "");
	if (!soap_tmp_ns__ledControlResponse || soap->error)
		return soap_recv_fault(soap, 0);
	if (soap_body_end_in(soap)
	 || soap_envelope_end_in(soap)
	 || soap_end_recv(soap))
		return soap_closesock(soap);
	if (result && soap_tmp_ns__ledControlResponse->result)
		*result = *soap_tmp_ns__ledControlResponse->result;
	return soap_closesock(soap);
}

int Proxy::motorControl(const char *endpoint, const char *soap_action, int motor_id, int motor_op, int *result)
{	struct soap *soap = this;
	struct ns__motorControl soap_tmp_ns__motorControl;
	struct ns__motorControlResponse *soap_tmp_ns__motorControlResponse;
	if (endpoint)
		soap_endpoint = endpoint;
	soap->encodingStyle = NULL;
	soap_tmp_ns__motorControl.motor_id = motor_id;
	soap_tmp_ns__motorControl.motor_op = motor_op;
	soap_begin(soap);
	soap_serializeheader(soap);
	soap_serialize_ns__motorControl(soap, &soap_tmp_ns__motorControl);
	if (soap_begin_count(soap))
		return soap->error;
	if (soap->mode & SOAP_IO_LENGTH)
	{	if (soap_envelope_begin_out(soap)
		 || soap_putheader(soap)
		 || soap_body_begin_out(soap)
		 || soap_put_ns__motorControl(soap, &soap_tmp_ns__motorControl, "ns:motorControl", NULL)
		 || soap_body_end_out(soap)
		 || soap_envelope_end_out(soap))
			 return soap->error;
	}
	if (soap_end_count(soap))
		return soap->error;
	if (soap_connect(soap, soap_url(soap, soap_endpoint, NULL), soap_action)
	 || soap_envelope_begin_out(soap)
	 || soap_putheader(soap)
	 || soap_body_begin_out(soap)
	 || soap_put_ns__motorControl(soap, &soap_tmp_ns__motorControl, "ns:motorControl", NULL)
	 || soap_body_end_out(soap)
	 || soap_envelope_end_out(soap)
	 || soap_end_send(soap))
		return soap_closesock(soap);
	if (!result)
		return soap_closesock(soap);
	soap_default_int(soap, result);
	if (soap_begin_recv(soap)
	 || soap_envelope_begin_in(soap)
	 || soap_recv_header(soap)
	 || soap_body_begin_in(soap))
		return soap_closesock(soap);
	soap_tmp_ns__motorControlResponse = soap_get_ns__motorControlResponse(soap, NULL, "ns:motorControlResponse", "");
	if (!soap_tmp_ns__motorControlResponse || soap->error)
		return soap_recv_fault(soap, 0);
	if (soap_body_end_in(soap)
	 || soap_envelope_end_in(soap)
	 || soap_end_recv(soap))
		return soap_closesock(soap);
	if (result && soap_tmp_ns__motorControlResponse->result)
		*result = *soap_tmp_ns__motorControlResponse->result;
	return soap_closesock(soap);
}

int Proxy::spiReadId(const char *endpoint, const char *soap_action, int *result)
{	struct soap *soap = this;
	struct ns__spiReadId soap_tmp_ns__spiReadId;
	struct ns__spiReadIdResponse *soap_tmp_ns__spiReadIdResponse;
	if (endpoint)
		soap_endpoint = endpoint;
	soap->encodingStyle = NULL;
	soap_begin(soap);
	soap_serializeheader(soap);
	soap_serialize_ns__spiReadId(soap, &soap_tmp_ns__spiReadId);
	if (soap_begin_count(soap))
		return soap->error;
	if (soap->mode & SOAP_IO_LENGTH)
	{	if (soap_envelope_begin_out(soap)
		 || soap_putheader(soap)
		 || soap_body_begin_out(soap)
		 || soap_put_ns__spiReadId(soap, &soap_tmp_ns__spiReadId, "ns:spiReadId", NULL)
		 || soap_body_end_out(soap)
		 || soap_envelope_end_out(soap))
			 return soap->error;
	}
	if (soap_end_count(soap))
		return soap->error;
	if (soap_connect(soap, soap_url(soap, soap_endpoint, NULL), soap_action)
	 || soap_envelope_begin_out(soap)
	 || soap_putheader(soap)
	 || soap_body_begin_out(soap)
	 || soap_put_ns__spiReadId(soap, &soap_tmp_ns__spiReadId, "ns:spiReadId", NULL)
	 || soap_body_end_out(soap)
	 || soap_envelope_end_out(soap)
	 || soap_end_send(soap))
		return soap_closesock(soap);
	if (!result)
		return soap_closesock(soap);
	soap_default_int(soap, result);
	if (soap_begin_recv(soap)
	 || soap_envelope_begin_in(soap)
	 || soap_recv_header(soap)
	 || soap_body_begin_in(soap))
		return soap_closesock(soap);
	soap_tmp_ns__spiReadIdResponse = soap_get_ns__spiReadIdResponse(soap, NULL, "ns:spiReadIdResponse", "");
	if (!soap_tmp_ns__spiReadIdResponse || soap->error)
		return soap_recv_fault(soap, 0);
	if (soap_body_end_in(soap)
	 || soap_envelope_end_in(soap)
	 || soap_end_recv(soap))
		return soap_closesock(soap);
	if (result && soap_tmp_ns__spiReadIdResponse->result)
		*result = *soap_tmp_ns__spiReadIdResponse->result;
	return soap_closesock(soap);
}

int Proxy::lm75ReadTemp(const char *endpoint, const char *soap_action, int *result)
{	struct soap *soap = this;
	struct ns__lm75ReadTemp soap_tmp_ns__lm75ReadTemp;
	struct ns__lm75ReadTempResponse *soap_tmp_ns__lm75ReadTempResponse;
	if (endpoint)
		soap_endpoint = endpoint;
	soap->encodingStyle = NULL;
	soap_begin(soap);
	soap_serializeheader(soap);
	soap_serialize_ns__lm75ReadTemp(soap, &soap_tmp_ns__lm75ReadTemp);
	if (soap_begin_count(soap))
		return soap->error;
	if (soap->mode & SOAP_IO_LENGTH)
	{	if (soap_envelope_begin_out(soap)
		 || soap_putheader(soap)
		 || soap_body_begin_out(soap)
		 || soap_put_ns__lm75ReadTemp(soap, &soap_tmp_ns__lm75ReadTemp, "ns:lm75ReadTemp", NULL)
		 || soap_body_end_out(soap)
		 || soap_envelope_end_out(soap))
			 return soap->error;
	}
	if (soap_end_count(soap))
		return soap->error;
	if (soap_connect(soap, soap_url(soap, soap_endpoint, NULL), soap_action)
	 || soap_envelope_begin_out(soap)
	 || soap_putheader(soap)
	 || soap_body_begin_out(soap)
	 || soap_put_ns__lm75ReadTemp(soap, &soap_tmp_ns__lm75ReadTemp, "ns:lm75ReadTemp", NULL)
	 || soap_body_end_out(soap)
	 || soap_envelope_end_out(soap)
	 || soap_end_send(soap))
		return soap_closesock(soap);
	if (!result)
		return soap_closesock(soap);
	soap_default_int(soap, result);
	if (soap_begin_recv(soap)
	 || soap_envelope_begin_in(soap)
	 || soap_recv_header(soap)
	 || soap_body_begin_in(soap))
		return soap_closesock(soap);
	soap_tmp_ns__lm75ReadTempResponse = soap_get_ns__lm75ReadTempResponse(soap, NULL, "ns:lm75ReadTempResponse", "");
	if (!soap_tmp_ns__lm75ReadTempResponse || soap->error)
		return soap_recv_fault(soap, 0);
	if (soap_body_end_in(soap)
	 || soap_envelope_end_in(soap)
	 || soap_end_recv(soap))
		return soap_closesock(soap);
	if (result && soap_tmp_ns__lm75ReadTempResponse->result)
		*result = *soap_tmp_ns__lm75ReadTempResponse->result;
	return soap_closesock(soap);
}

int Proxy::adcReadValue(const char *endpoint, const char *soap_action, int *result)
{	struct soap *soap = this;
	struct ns__adcReadValue soap_tmp_ns__adcReadValue;
	struct ns__adcReadValueResponse *soap_tmp_ns__adcReadValueResponse;
	if (endpoint)
		soap_endpoint = endpoint;
	soap->encodingStyle = NULL;
	soap_begin(soap);
	soap_serializeheader(soap);
	soap_serialize_ns__adcReadValue(soap, &soap_tmp_ns__adcReadValue);
	if (soap_begin_count(soap))
		return soap->error;
	if (soap->mode & SOAP_IO_LENGTH)
	{	if (soap_envelope_begin_out(soap)
		 || soap_putheader(soap)
		 || soap_body_begin_out(soap)
		 || soap_put_ns__adcReadValue(soap, &soap_tmp_ns__adcReadValue, "ns:adcReadValue", NULL)
		 || soap_body_end_out(soap)
		 || soap_envelope_end_out(soap))
			 return soap->error;
	}
	if (soap_end_count(soap))
		return soap->error;
	if (soap_connect(soap, soap_url(soap, soap_endpoint, NULL), soap_action)
	 || soap_envelope_begin_out(soap)
	 || soap_putheader(soap)
	 || soap_body_begin_out(soap)
	 || soap_put_ns__adcReadValue(soap, &soap_tmp_ns__adcReadValue, "ns:adcReadValue", NULL)
	 || soap_body_end_out(soap)
	 || soap_envelope_end_out(soap)
	 || soap_end_send(soap))
		return soap_closesock(soap);
	if (!result)
		return soap_closesock(soap);
	soap_default_int(soap, result);
	if (soap_begin_recv(soap)
	 || soap_envelope_begin_in(soap)
	 || soap_recv_header(soap)
	 || soap_body_begin_in(soap))
		return soap_closesock(soap);
	soap_tmp_ns__adcReadValueResponse = soap_get_ns__adcReadValueResponse(soap, NULL, "ns:adcReadValueResponse", "");
	if (!soap_tmp_ns__adcReadValueResponse || soap->error)
		return soap_recv_fault(soap, 0);
	if (soap_body_end_in(soap)
	 || soap_envelope_end_in(soap)
	 || soap_end_recv(soap))
		return soap_closesock(soap);
	if (result && soap_tmp_ns__adcReadValueResponse->result)
		*result = *soap_tmp_ns__adcReadValueResponse->result;
	return soap_closesock(soap);
}
/* End of client proxy code */
